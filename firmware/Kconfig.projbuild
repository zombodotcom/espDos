## firmware/Kconfig.projbuild
```kconfig
## Workaround: in ESP-IDF 6.0.1 on ESP32-C5, the root Kconfig's
##     orsource "./components/soc/$IDF_TARGET/include/soc/Kconfig.soc_caps.in"
## doesn't propagate ~133 of the 332 SOC_* capabilities into the
## resolved sdkconfig. SOC_USB_SERIAL_JTAG_SUPPORTED is one of them,
## which causes esp_driver_usb_serial_jtag's CMakeLists to skip its
## source files (gated on `if(CONFIG_SOC_USB_SERIAL_JTAG_SUPPORTED)`).
## bios.c then fails to link with `usb_serial_jtag_write_bytes` undefined.
##
## We re-declare the missing SOC_* configs we depend on here, with
## the same `default y if IDF_TARGET_ESP32C5` semantics. Kconfig
## merges the declarations: the upstream Kconfig.soc_caps.in still
## owns the canonical declaration on chips where it's properly
## sourced (S3, etc.); on C5 our declaration provides the value.
##
## Remove this file when upstream IDF fixes the missing orsource on C5.

config SOC_USB_SERIAL_JTAG_SUPPORTED
    bool
    default y if IDF_TARGET_ESP32C5
```

## firmware/components/display/Kconfig
```kconfig
menu "espDos display"

    config ESPDOS_HAS_DISPLAY
        bool "Enable LCD display mirror"
        default n
        help
            Enable mirroring of BIOS console output to an onboard LCD.
            On targets with no LCD wired (e.g. T-Display-S3 in espDos
            today), leave this off — the display API compiles out to
            inline no-ops.

    config ESPDOS_DISPLAY_SUBPIXEL
        bool "Use subpixel-rendered 80-column log"
        depends on ESPDOS_HAS_DISPLAY
        default y
        help
            When on, log rows are rendered with Bowman/ClearType-style
            subpixel anti-aliasing, giving 80 columns on a 160-pixel-
            wide ST7735 (true DOS width). Status bar always uses sharp
            26-column rendering so the always-visible chrome has no
            color fringing. When off, both regions use sharp 26-col.

    config ESPDOS_DISPLAY_CALIBRATION
        bool "Render subpixel calibration pattern at boot"
        depends on ESPDOS_HAS_DISPLAY
        default n
        help
            On boot, render three horizontal bars colored exclusively
            in subpixel 0/1/2 of each pixel triplet, then sleep 5 s
            before normal display init. Use to verify panel stripe
            order (BGR vs RGB). Should normally be off.

endmenu
```

## firmware/sdkconfig.defaults
```kconfig
# espdos shared sdkconfig defaults.
# Per-target overlays in sdkconfig.defaults.esp32{s3,c5} pick PSRAM
# mode and display enablement.

# Performance: -O2 + 240 MHz CPU. Both S3 and C5 support 240 MHz.
CONFIG_COMPILER_OPTIMIZATION_PERF=y
CONFIG_ESP_DEFAULT_CPU_FREQ_MHZ_240=y
CONFIG_ESP_DEFAULT_CPU_FREQ_MHZ=240

# Enable PSRAM. Mode (octal vs quad) is set by the target overlay.
CONFIG_SPIRAM=y
CONFIG_SPIRAM_TYPE_AUTO=y
CONFIG_SPIRAM_SPEED_80M=y

# Allow heap_caps_malloc(MALLOC_CAP_SPIRAM, ...) at runtime.
CONFIG_SPIRAM_USE_MALLOC=y

# Allow EXT_RAM_BSS_ATTR-tagged statics (esp8086.c's mem[]) to land in
# PSRAM. Without this, EXT_RAM_BSS_ATTR silently does nothing and the
# 1 MB mem[] array tries to fit in internal DRAM, which fails.
CONFIG_SPIRAM_ALLOW_BSS_SEG_EXTERNAL_MEMORY=y

# Don't fail to boot if PSRAM init fails (QEMU may differ from real chip).
CONFIG_SPIRAM_IGNORE_NOTFOUND=y

# Larger main task stack — emulator-driven workloads may want it.
CONFIG_ESP_MAIN_TASK_STACK_SIZE=8192

# 16 MB flash on both LilyGO boards. Default sdkconfig says 2 MB,
# which can't hold the 3 MB factory app + dos_disk partition.
CONFIG_ESPTOOLPY_FLASHSIZE_16MB=y
CONFIG_ESPTOOLPY_FLASHSIZE="16MB"

# Custom partition table (adds dos_disk for the FAT12 floppy image).
CONFIG_PARTITION_TABLE_CUSTOM=y
CONFIG_PARTITION_TABLE_CUSTOM_FILENAME="partitions.csv"
CONFIG_PARTITION_TABLE_FILENAME="partitions.csv"
```

## firmware/sdkconfig.defaults.esp32c5
```kconfig
# C5-specific overlay for sdkconfig.defaults.
# Loaded automatically by `idf.py set-target esp32c5`.

CONFIG_IDF_TARGET="esp32c5"

# Quad SPI PSRAM. ESP32-C5 silicon only supports quad (no octal mode
# like S3). Pin assignments are chip defaults; the LilyGO T-Dongle-C5
# uses the standard quad SPI psram pinout.
CONFIG_SPIRAM_MODE_QUAD=y

# Display is wired on T-Dongle-C5 (ST7735 over SPI2, GPIO 0/1/2/3/6/10).
# Subpixel rendering on by default; flip ESPDOS_DISPLAY_SUBPIXEL=n in
# menuconfig to fall back to sharp 26-col mode.
CONFIG_ESPDOS_HAS_DISPLAY=y
CONFIG_ESPDOS_DISPLAY_SUBPIXEL=y
```

## firmware/sdkconfig.defaults.esp32s3
```kconfig
# S3-specific overlay for sdkconfig.defaults.
# Loaded automatically by `idf.py set-target esp32s3`.

CONFIG_IDF_TARGET="esp32s3"

# Octal PSRAM: T-Display-S3 default. C5 cannot do octal — it uses quad
# (see sdkconfig.defaults.esp32c5).
CONFIG_SPIRAM_MODE_OCT=y

# Display is not wired up on the T-Display-S3 in espDos. Compiles out.
CONFIG_ESPDOS_HAS_DISPLAY=n
```
